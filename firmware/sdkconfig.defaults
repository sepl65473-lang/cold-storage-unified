## firmware/sdkconfig.defaults
```kconfig
# Hardware / WiFi
CONFIG_ESP32_WIFI_ENABLED=y
CONFIG_ESP_WIFI_SSID="YOUR_WIFI_SSID"
CONFIG_ESP_WIFI_PASSWORD="YOUR_WIFI_PASSWORD"

# AWS IoT / MQTT Config
CONFIG_AWS_IOT_ENDPOINT="YOUR_AWS_IOT_ENDPOINT-ats.iot.REGION.amazonaws.com"
CONFIG_MQTT_CLIENT_ID="cs_esp32_001"
CONFIG_MQTT_BROKER_URL="mqtts://${CONFIG_AWS_IOT_ENDPOINT}:8883"

# Flash/Partition size for OTA (At least 4MB flash recommended for OTA)
CONFIG_ESPTOOLPY_FLASHSIZE_4MB=y
CONFIG_PARTITION_TABLE_TWO_OTA=y

# FreeRTOS config
CONFIG_FREERTOS_HZ=1000

# Stack sizes
CONFIG_ESP_MAIN_TASK_STACK_SIZE=8192
CONFIG_MQTT_TASK_STACK_SIZE=6144

# MBEDTLS - Require for AWS IoT Rules
CONFIG_MBEDTLS_CMAC_C=y
CONFIG_MBEDTLS_ASYMMETRIC_CONTENT_LEN=y
```
